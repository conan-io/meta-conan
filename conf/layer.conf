## conf/layer.conf
```bitbake
# We have a conf and classes directory, add to BBPATH
BBPATH .= ":${LAYERDIR}"

# We have recipes-* directories, add to BBFILES
BBFILES += "${LAYERDIR}/recipes-*/*.bb \
            ${LAYERDIR}/recipes-*/*.bbappend"

BBFILE_COLLECTIONS += "meta-conan"
BBFILE_PATTERN_meta-conan = "^${LAYERDIR}/"
BBFILE_PRIORITY_meta-conan = "6"

LAYERDEPENDS_meta-conan = "core meta-python"
LAYERSERIES_COMPAT_meta-conan = "zeus"
```
